## kernel/Kconfig
```kconfig
menu "upgrades.systems"
config UPGRADES_ADAPTER
	bool "upgrades.systems kernel adapter"
	depends on NET && BLOCK
	help
	  Built-in main and net. Not a module.
endmenu
```
